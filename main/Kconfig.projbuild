## main/Kconfig.projbuild
```kconfig
menu "ATL200"

    config ATL_LED_GPIO
        int "LED GPIO number"
        range 0 48
        default 48
        help
            GPIO number (IOxx) to blink on and off the LED.
    
    config ATL_LED_PERIOD
        int "LED blink period (in ms)"
        range 100 3600000
        default 2000
        help
            Define the blinking period (in milliseconds).
    
    config ATL_BUTTON_BUILTIN_PIN
        int "Button GPIO number"
        range 0 48
        default 0
        help
            GPIO number (IOxx) for the built-in button.

endmenu
```
